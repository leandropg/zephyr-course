## app/boards/my_st_f429/Kconfig.defconfig
```kconfig
# MY ST F429 board configuration

# Copyright (c) 2017 Linaro Limited
# SPDX-License-Identifier: Apache-2.0

if BOARD_MY_ST_F429

configdefault NET_L2_ETHERNET
	default y

endif # BOARD_MY_ST_F429
```

## app/boards/my_st_f429/Kconfig.my_st_f429
```kconfig
# Copyright (c) 2017 Linaro Limited
# SPDX-License-Identifier: Apache-2.0

config BOARD_MY_ST_F429
	select SOC_STM32F429XX
```

## app/boards/my_st_f429/board.yml
```yaml
board:
  name: my_st_f429
  full_name: My ST Nucleo F429
  vendor: iomico
  socs:
    - name: stm32f429xx
```

## boards/your_st_f429/board.yml
```yaml
board:
  name: your_st_f429
  full_name: Your ST Nucleo F429
  vendor: iomico
  socs:
    - name: stm32f429xx
```

## dts/bindings/onboard_led.yaml
```yaml
description: Onboard Led Driver
compatible: "onboard_led,driver"
include: base.yaml
```
